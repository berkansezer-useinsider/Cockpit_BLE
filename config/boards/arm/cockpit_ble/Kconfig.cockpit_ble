## config/boards/arm/cockpit_ble/Kconfig.cockpit_ble
```kconfig
# cockpit_ble board configuration

# Copyright (c) 2023 ozkan (github.com/ozkan)
# SPDX-License-Identifier: MIT

config BOARD_COCKPIT_BLE
	select SOC_NRF52840_QIAA

config BOARD_NRFMICRO_CHARGER
	bool "Enable battery charger"
	default y
	depends on BOARD_COCKPIT_BLE
```

## config/boards/arm/cockpit_ble/board.yml
```yaml
board:
  name: cockpit_ble
  vendor: ozkancelik
  socs:
    - name: nrf52840
      variants:
        - name: qiaa
```
